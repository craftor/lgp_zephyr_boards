## boards/esp32s3_lcd_1.47/board.yml
```yaml
board:
  name: esp32s3_lcd_1_47
  full_name: ESP32S3-LCD-1.47
  vendor: luatos
  socs:
  - name: esp32s3
    variants:
    - name: usb
      cpucluster: procpu
    - name: usb
      cpucluster: appcpu
```

## esp32s3_usb_lcd_1.47/board.yml
```yaml
board:
  name: esp32s3_iot
  full_name: ESP32-S3-IoT
  vendor: espressif
  socs:
  - name: esp32s3
```
